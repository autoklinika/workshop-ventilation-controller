## firmware/sensor-node/components/app/Kconfig.projbuild
```kconfig
menu "WVC sensor-node test hooks"

    config WVC_OTA_ROLLBACK_TEST_IMAGE
        bool "Build deterministic OTA rollback test image"
        default n
        help
            Test-only hook for hardware validation of ESP-IDF A/B rollback.
            When enabled, a freshly installed OTA image which is running in
            ESP_OTA_IMG_PENDING_VERIFY state performs a controlled restart
            before the normal health-confirmation window can complete.
            The bootloader must then roll back to the previous valid image.

            Keep this disabled for every normal/production firmware build.

endmenu
```

## firmware/sensor-node/components/config/Kconfig.projbuild
```kconfig
menu "Workshop ventilation sensor node"

config WVC_MODBUS_SLAVE_ADDRESS_DEFAULT
    int "Default Modbus RTU slave address"
    range 1 247
    default 1
    help
        Safe fallback used only when no locally provisioned address exists in
        NVS. Production nodes should be provisioned locally as address 1 or 2.

endmenu
```
